## boards/arm/ardufox/Kconfig.ardufox
```kconfig
# ardufox DK NRF9160 board configuration

# Copyright (c) 2018-2020 Nordic Semiconductor ASA
# SPDX-License-Identifier: Apache-2.0

config BOARD_ARDUFOX
	select SOC_NRF9160_SICA if BOARD_ARDUFOX_NRF9160 || BOARD_ARDUFOX_NRF9160_NS
```

## boards/arm/ardufox/ardufox_nrf9160_ns_defconfig
```kconfig
# SPDX-License-Identifier: Apache-2.0

# Enable MPU
CONFIG_ARM_MPU=y

# Enable hardware stack protection
CONFIG_HW_STACK_PROTECTION=y

# Enable TrustZone-M
CONFIG_ARM_TRUSTZONE_M=y

# This Board implies building Non-Secure firmware
CONFIG_TRUSTED_EXECUTION_NONSECURE=y

# Enable GPIO
CONFIG_GPIO=y

#Enable SPI 
CONFIG_SPI=y

# Enable uart driver
CONFIG_SERIAL=n

# Enable console
CONFIG_CONSOLE=n
CONFIG_UART_CONSOLE=n
```

## boards/arm/ardufox/board.yml
```yaml
board:
  name: ardufox
  vendor: nordic
  socs:
  - name: nrf9160
    variants:
    - name: 'ns'
  revision:
    format: major.minor.patch
    default: "1.0.7"
    revisions:
    - name: "1.0.6"
    - name: "1.0.7"
```

## boards/arm/ardufox/dts/bindings/nordic,ardufox-nrf52840-reset.yaml
```yaml
# Copyright (c) 2021 Nordic Semiconductor ASA
# SPDX-License-Identifier: Apache-2.0

# NOTE: This file is replicated in ardufox_nrf9160 and ardufox_nrf52840.
#       Any changes should be done in both instances.

description: GPIO used to reset nRF52840 on ardufox DK

compatible: "nordic,ardufox-nrf52840-reset"

include: base.yaml

properties:
  status:
    required: true

  gpios:
    type: phandle-array
    required: true
    description: |
      GPIO to use as nRF52840 reset line: output in nRF9160, input in nRF52840.
```

## boards/arm/ardufox/dts/bindings/nordic,ardufox-optional-routing.yaml
```yaml
# Copyright 2021 Nordic Semiconductor ASA
# SPDX-License-Identifier: Apache-2.0

description: ardufox DK optional routing provided by analog switch

compatible: "nordic,ardufox-optional-routing"

include: base.yaml

properties:
  status:
    required: true

  control-gpios:
    type: phandle-array
    required: true
    description: |
      GPIO to use to control the analog switch.
```

## boards/arm/msense_dev/Kconfig.board
```kconfig
# Copyright (c) 2024 Nordic Semiconductor ASA
# SPDX-License-Identifier: Apache-2.0

config BOARD_MSENSE_DEV
	bool "msense-dev"
	depends on SOC_NRF9160_SICA
```

## boards/arm/msense_dev/Kconfig.defconfig
```kconfig
# Copyright (c) 2024 Nordic Semiconductor ASA
# SPDX-License-Identifier: Apache-2.0

if BOARD_MSENSE_DEV

config BOARD
	default "msense_dev"


#Build with TF-M as the Secure Execution Environment
config BUILD_WITH_TFM
	default n
endif
```

## boards/arm/msense_dev/msense_dev_defconfig
```kconfig
# Copyright (c) 2024 Nordic Semiconductor ASA
# SPDX-License-Identifier: Apache-2.0

CONFIG_SOC_SERIES_NRF91X=y
CONFIG_SOC_NRF9160_SICA=y
CONFIG_BOARD_MSENSE_DEV=y

# Enable MPU
CONFIG_ARM_MPU=y

# Enable TrustZone-M
CONFIG_ARM_TRUSTZONE_M=y

CONFIG_TRUSTED_EXECUTION_NONSECURE=y

# Enable PINCTRL
CONFIG_PINCTRL=y

# Enable GPIO
CONFIG_GPIO=y

# Enable UARTE
CONFIG_SERIAL=y

# Enable console
CONFIG_CONSOLE=y
CONFIG_UART_CONSOLE=y
```

## boards/arm/msense_thingy/Kconfig.msenseThingy
```kconfig
# Copyright (c) 2019 Nordic Semiconductor ASA
# SPDX-License-Identifier: LicenseRef-Nordic-5-Clause

config BOARD_MSENSETHINGY
	select SOC_NRF52840_QIAA if BOARD_MSENSETHINGY_NRF52840
	select SOC_NRF9160_SICA if BOARD_MSENSETHINGY_NRF9160 || BOARD_MSENSETHINGY_NRF9160_NS
```

## boards/arm/msense_thingy/board.yml
```yaml
board:
  name: msenseThingy
  vendor: nordic
  socs:
    - name: nrf52840
    - name: nrf9160
      variants:
        - name: ns
```

## boards/arm/nrf9160devkittest/Kconfig
```kconfig
# nRF9160 DK NRF52840 board configuration

# Copyright (c) 2018-2020 Nordic Semiconductor ASA
# SPDX-License-Identifier: Apache-2.0

config BOARD_NRF9160DEVKITTEST
	# The GPIO driver is required by this board's initialization code
	# (board.c), so it is forced here to be enabled always, not only
	# enabled by default (in defconfig).
	select GPIO if BOARD_NRF9160DEVKITTEST_NRF52840

if BOARD_NRF9160DEVKITTEST_NRF52840

config BOARD_ENABLE_DCDC
	bool "DCDC mode"
	select SOC_DCDC_NRF52X
	default y

module = BOARD_NRF9160DEVKITTEST
module-str = Board Control
source "subsys/logging/Kconfig.template.log_config"

endif # BOARD_NRF9160DEVKITTEST_NRF52840
```

## boards/arm/nrf9160devkittest/Kconfig.nrf9160devkittest
```kconfig
# nRF9160 DK NRF9160 board configuration

# Copyright (c) 2018-2020 Nordic Semiconductor ASA
# SPDX-License-Identifier: Apache-2.0

config BOARD_NRF9160DEVKITTEST
	select SOC_NRF9160_SICA if BOARD_NRF9160DEVKITTEST_NRF9160 || BOARD_NRF9160DEVKITTEST_NRF9160_NS
	select SOC_NRF52840_QIAA if BOARD_NRF9160DEVKITTEST_NRF52840
```
