/*
 * Copyright (c) 2023 Nordic Semiconductor ASA
 *
 * SPDX-License-Identifier: LicenseRef-Nordic-5-Clause
 */

/ {
	aliases {
		accelerometer = &adxl362;
	};
};

&spi3 {
	adxl362: adxl362@0 {
		autosleep;
	};
};
